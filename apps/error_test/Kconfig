## apps/error_test/Kconfig
```kconfig
#
# Copyright 2014, NICTA
#
# This software may be distributed and modified according to the terms of
# the BSD 2-Clause license. Note that NO WARRANTY is provided.
# See "LICENSE_BSD2.txt" for details.
#
# @TAG(NICTA_BSD)
#

config APP_ERROR_TEST
    bool "Error test"
    depends on LIB_SEL4 && HAVE_LIBC && LIB_SOS
    select HAVE_SEL4_APPS
    help
        A set of tests to ensure that sos responds to invalid input correctly. 
```

## apps/execstack/Kconfig
```kconfig
config APP_EXEC_STACK
	bool "New execstack"
	depends on LIB_SEL4 && HAVE_LIBC && LIB_SOS
	select HAVE_SEL4_APPS
	help
		Tries to execute stack pointer
```

## apps/game/Kconfig
```kconfig
config APP_GAME
    bool "Game"
    depends on LIB_SEL4 && HAVE_LIBC && LIB_SOS
    select HAVE_SEL4_APPS
    help
        A new app
```

## apps/newapp/Kconfig
```kconfig
config APP_NEWAPP
    bool "New app"
    depends on LIB_SEL4 && HAVE_LIBC && LIB_SOS
    select HAVE_SEL4_APPS
    help
        A new app
```

## apps/pagingdemo/Kconfig
```kconfig
config APP_PAGINGDEMO
    bool "Paging Demo"
    depends on LIB_SEL4 && HAVE_LIBC && LIB_SOS
    select HAVE_SEL4_APPS
    help
        A paging demo app
```

## apps/thrash/Kconfig
```kconfig
config APP_THRASH
    bool "Thrash"
    depends on LIB_SEL4 && HAVE_LIBC && LIB_SOS
    select HAVE_SEL4_APPS
    help
        A new app
```

## libs/libmuslc/Kconfig
```kconfig
# @LICENSE(NICTA)

menuconfig LIB_MUSL_C
    bool "Build musl C library"
    default y
    select HAVE_LIBC
    help
        Build Musl C standard library.

config LIB_MUSL_C_USE_PREBUILT
    bool "libmuslc use precompiled archive"
    default y
    depends on LIB_MUSL_C
    help
        If available, use the precompiled archive to improve project compile time.
        This option was introduced because it takes a significant amount of time to 
        compile this library and this library is not likely to change.

config HAVE_LIBC
    bool
    default y
    depends on LIB_SEL4_C || LIB_MUSL_C

config BREAK
    bool
```

## libs/libsel4sync/Kconfig
```kconfig
config LIB_SEL4_SYNC
    bool "Build sel4sync"
    select LIB_SEL4 
    select LIB_SEL4_C
    select HAVE_SEL4_LIBS
    default y
    help
        "Synchronization library for seL4"
```
